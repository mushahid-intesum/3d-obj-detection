## esp32/archive/main/Kconfig.projbuild
```kconfig
menu "MCU ImageNav Configuration"

    config WIFI_SSID
        string "WiFi SSID"
        default "Network"
        help
            SSID of the WiFi access point to connect to.

    config WIFI_PASSWORD
        string "WiFi Password"
        default "Excels!or"
        help
            Password for the WiFi access point.

endmenu
```
